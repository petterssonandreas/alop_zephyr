## boards/ct_g0b0ke/board.yml
```yaml
board:
  name: ct_g0b0ke
  full_name: CT G0B0KE
  vendor: st
  socs:
    - name: stm32g0b0xx
```

## west.yml
```yaml
manifest:
  remotes:
    - name: zephyrproject-rtos
      url-base: https://github.com/zephyrproject-rtos

  projects:
    - name: zephyr
      remote: zephyrproject-rtos
      revision: v4.2.0
      import:
        # By using name-allowlist we can clone only the modules that are
        # strictly needed by the application.
        name-allowlist:
          - cmsis_6    # required by the ARM port for Cortex-M
          - hal_nordic # required by Nordic boards
          - hal_stm32  # required by STM32 boards
          - loramac-node
```
