## CMakeLists.txt
```
# SPDX-License-Identifier: Apache-2.0

cmake_minimum_required(VERSION 3.20.0)
find_package(Zephyr REQUIRED HINTS $ENV{ZEPHYR_BASE})
project(lora)

target_sources(app PRIVATE
    src/main.c
)
zephyr_include_directories(src)
```

## Kconfig
```
menu "LORA app configuration"

module = LORA_MAIN
module-str = LORA-Main
source "subsys/logging/Kconfig.template.log_config"

endmenu

source "Kconfig.zephyr"
```

## prj.conf
```kconfig
# Basic
CONFIG_GPIO=y
CONFIG_PWM=y

# Shell
CONFIG_PRINTK=y
CONFIG_SHELL=y
CONFIG_LOG_CMDS=y
CONFIG_INIT_STACKS=y
CONFIG_THREAD_STACK_INFO=y
CONFIG_KERNEL_SHELL=y
CONFIG_THREAD_MONITOR=y
CONFIG_BOOT_BANNER=y
CONFIG_THREAD_NAME=y
CONFIG_DEVICE_SHELL=y
CONFIG_THREAD_RUNTIME_STATS=y
CONFIG_THREAD_RUNTIME_STATS_USE_TIMING_FUNCTIONS=y
CONFIG_STATS=y
CONFIG_STATS_SHELL=y

# Logs
CONFIG_LOG=y
CONFIG_LOG_MODE_DEFERRED=y
# CONFIG_LOG_MODE_IMMEDIATE=y
# CONFIG_LOG_RUNTIME_FILTERING=y
CONFIG_LOG_BUFFER_SIZE=2048
CONFIG_LOG_PRINTK=y
CONFIG_LOG_PROCESS_TRIGGER_THRESHOLD=1
CONFIG_COVERAGE=n
CONFIG_LOG_TAG_MAX_LEN=8

# I2C
CONFIG_I2C=y
CONFIG_I2C_SHELL=y

# # Display
# CONFIG_DISPLAY=y
# CONFIG_SSD1306=y
# CONFIG_DISPLAY_LOG_LEVEL_INF=y
# CONFIG_CHARACTER_FRAMEBUFFER=y
# # Required for framebuffer
# CONFIG_HEAP_MEM_POOL_SIZE=16384

# RTC
CONFIG_RTC=y
CONFIG_CLOCK_CONTROL=y
CONFIG_RTC_SHELL=y

# ADC
CONFIG_ADC=y
CONFIG_ADC_STM32=y
CONFIG_ADC_SHELL=y

# Asserts
CONFIG_ASSERT=y

# SPI
CONFIG_SPI=y
CONFIG_SPI_SHELL=y
CONFIG_SPI_STATS=y

# LoRa
CONFIG_LORA=y
CONFIG_LORA_LOG_LEVEL_DBG=y
CONFIG_LORA_SHELL=y
```

## src/main.c
```c
/*
 * Copyright (c) 2016 Open-RnD Sp. z o.o.
 * Copyright (c) 2020 Nordic Semiconductor ASA
 *
 * SPDX-License-Identifier: Apache-2.0
 */

#include <zephyr/kernel.h>
#include <zephyr/device.h>
#include <zephyr/sys/util.h>
#include <zephyr/sys/printk.h>
#include <zephyr/drivers/lora.h>
#include <zephyr/drivers/pwm.h>

#include <zephyr/logging/log.h>
LOG_MODULE_REGISTER(lora_main, CONFIG_LORA_MAIN_LOG_LEVEL);

#define DEFAULT_RADIO_NODE DT_ALIAS(lora0)
BUILD_ASSERT(DT_NODE_HAS_STATUS_OKAY(DEFAULT_RADIO_NODE),
         "No default LoRa radio specified in DT");

#define MAX_DATA_LEN 12

char data[MAX_DATA_LEN] = {'h', 'e', 'l', 'l', 'o', 'w', 'o', 'r', 'l', 'd', ' ', '0'};

#define PWM_LED_PERIOD NSEC_PER_MSEC

static const struct pwm_dt_spec ui_led = PWM_DT_SPEC_GET(DT_ALIAS(uiled));

static uint32_t current_ui_led_pulse = 0;

int main(void)
{
    int ret = 0;

    LOG_INF("main starting");

    if (!pwm_is_ready_dt(&ui_led)) {
        LOG_ERR("Error: PWM device %s is not ready", ui_led.dev->name);
        return -ENODEV;
    }
    ret = pwm_set_dt(&ui_led, PWM_LED_PERIOD, 0);
    if (ret < 0) {
        LOG_ERR("Error %d: failed to set pulse width", ret);
        return ret;
    }
    LOG_INF("PWM LEDs init done");


    const struct device *const lora_dev = DEVICE_DT_GET(DEFAULT_RADIO_NODE);
    struct lora_modem_config config;

    if (!device_is_ready(lora_dev)) {
        LOG_ERR("%s Device not ready", lora_dev->name);
        return 0;
    }

    config.frequency = 868000000;
    config.bandwidth = BW_125_KHZ;
    config.datarate = SF_10;
    config.preamble_len = 8;
    config.coding_rate = CR_4_5;
    config.iq_inverted = false;
    config.public_network = false;
    config.tx_power = 4;
    config.tx = true;

    ret = lora_config(lora_dev, &config);
    if (ret < 0) {
        LOG_ERR("LoRa config failed");
        return 0;
    }

    while (true) {
        ret = lora_send(lora_dev, data, MAX_DATA_LEN);
        if (ret < 0) {
            LOG_ERR("LoRa send failed %d", ret);
            // return 0;
        }

        LOG_INF("Data sent %c!", data[MAX_DATA_LEN - 1]);

        /* Send data at 1s interval */
        k_sleep(K_MSEC(1000));

        /* Increment final character to differentiate packets */
        if (data[MAX_DATA_LEN - 1] == '9') {
            data[MAX_DATA_LEN - 1] = '0';
        } else {
            data[MAX_DATA_LEN - 1] += 1;
        }


        /* Blink */
        if (current_ui_led_pulse > 0) {
            pwm_set_pulse_dt(&ui_led, 0);
            current_ui_led_pulse = 0;
        }
        else {
            pwm_set_pulse_dt(&ui_led, PWM_LED_PERIOD);
            current_ui_led_pulse = PWM_LED_PERIOD;
        }

    }

    return 0;
}
```
